## drivers/power/Kconfig
```kconfig
# SPDX-License-Identifier: GPL-2.0-only
source "drivers/power/reset/Kconfig"
source "drivers/power/sequencing/Kconfig"
source "drivers/power/supply/Kconfig"

# ==== SPRD power (ported from 4.4 vendor tree) ====

config BATTERY_SPRD
	tristate "Spreadtrum  SoC's power supply& mesurement controller"
	help
	  Say Y to include support for Spreadtrum SoC's power supply and
	  mesurement controller drive

config CHARGER_SC2705
	tristate "Spreadtrum Communications SC2705 Charger support"
	depends on MFD_SC2705
	help
	  Say Y here to enable support for charger unit of the SC2705 Charger.
	  This driver can also be built as a module. If so, the module will be
	  called sc2705-charger.

config CHARGER_SC2703
	tristate "Spreadtrum Communications SC2703 Charger support"
	depends on MFD_SC2703
	help
	  Say Y here to enable support for charger unit of the SC2703 Charger.
	  This driver can also be built as a module. If so, the module will be
	  called sc2703-charger.

config CHARGER_SC2723
	tristate "Spreadtrum 2723 Charger"
	depends on BATTERY_SPRD
	help
	  Say Y to include support for Spreadtrum 2723 Charger.

config CHARGER_SC2721
	tristate "Spreadtrum 2721 Charger"
	depends on BATTERY_SPRD
	help
	  Say Y to include support for Spreadtrum 2721 Charger.

config CHARGER_SC2720
	tristate "Spreadtrum 2720 Charger"
	depends on BATTERY_SPRD
	help
	  Say Y to include support for Spreadtrum 2720 Charger.

config CHARGER_SC2731
	tristate "Spreadtrum 2731 Charger"
	depends on BATTERY_SPRD
	help
	  Say Y to include support for Spreadtrum 2731 Charger.

config CHARGER_FAN54015
	tristate "Fairchild FAN54015 Charger"
	depends on I2C
	depends on BATTERY_SPRD
	help
	  Say Y to include support for Fairchild FAN54015 Battery Charger.

config CHARGER_SPRD2701
	tristate "Spreadtrum 2701 Charger"
	depends on I2C
	depends on BATTERY_SPRD
	help
	  Say Y to include support for Spreadtrum 2701 Battery Charger.

config CHARGER_SPRD2700
	tristate "Spreadtrum 2700 Charger"
	depends on I2C
	depends on BATTERY_SPRD
	help
	  Say Y to include support for Spreadtrum 2700 Battery Charger.

config FGU_SC27XX
	tristate "Spreadtrum 27xx fgu"
	depends on BATTERY_SPRD
	help
	  Say Y to include support for Spreadtrum 27xx fgu.
source "drivers/power/reset_vendor/Kconfig"
```

## fs/exfat/Kconfig
```kconfig
# SPDX-License-Identifier: GPL-2.0-or-later

config EXFAT_FS
	tristate "exFAT filesystem support"
	select BUFFER_HEAD
	select NLS
	select FS_IOMAP
	help
	  This allows you to mount devices formatted with the exFAT file system.
	  exFAT is typically used on SD-Cards or USB sticks.

	  To compile this as a module, choose M here: the module will be called
	  exfat.

config EXFAT_DEFAULT_IOCHARSET
	string "Default iocharset for exFAT"
	default "utf8"
	depends on EXFAT_FS
	help
	  Set this to the default input/output character set to use for
	  converting between the encoding that is used for user visible
	  filenames and the UTF-16 character encoding that the exFAT
	  filesystem uses.  This can be overridden with the "iocharset" mount
	  option for the exFAT filesystems.

config EXFAT_VIRTUAL_XATTR
	bool "Virtual xattr support for exFAT filesystem"
	default n
	depends on EXFAT_FS
	help
	  Modification of exFAT filesystem for virtual xattr

config EXFAT_VIRTUAL_XATTR_SELINUX_LABEL
	string "Default string for SELinux label"
	depends on EXFAT_FS && EXFAT_VIRTUAL_XATTR
	default "u:object_r:sdcard_external:s0"
	help
	  Set this to the default string for SELinux label.
```

## sound/soc/sprd_sharkle/dai/vbc/Kconfig
```kconfig
menu "SPRD VBC Dai Version"
source "sound/soc/sprd_sharkle/dai/vbc/r1p0v3/Kconfig"
source "sound/soc/sprd_sharkle/dai/vbc/r3p0/Kconfig"

endmenu
```
