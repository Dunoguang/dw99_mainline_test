/*
* Copyright (C) 2015 Spreadtrum Communication Incorporated
*		http://www.spreadtrum.com/
*
* This program is free software; you can redistribute it and/or modify
* it under the terms of the GNU General Public License version 2 as
* published by the Free Software Foundation.
*/

/* This is the sprd battery default DTS */
/{
	battery: battery {
		compatible = "sprd,sprd-battery";
		status = "okay";
		battery-adapt-support = <0>;
		battery-adapt-fun = <0>;
		chg-end-vol = <4400>;
		chg-end-vol-check = <4380>;
		chg-bat-safety-vol = <4480>;
		fchg-vol = <9000>;
		rechg-vol = <4330>;
		adp-cdp-cur = <1000>;
		adp-dcp-cur = <1000>;
		adp-sdp-cur = <450>;
		adp-unknown-cur = <450>;
		adp-fchg-cur = <1000>;
		adp-cdp-cur-limit = <1000>;
		adp-dcp-cur-limit = <1000>;
		adp-sdp-cur-limit = <500>;
		adp-fchg-cur-limit = <1000>;
		adp-unknown-cur-limit = <500>;
		ovp-stop = <6500>;
		ovp-restart = <5800>;
		fchg-ovp-stop = <11000>;
		fchg-ovp-restart = <10000>;
		chg-timeout = <21600>;
		chg-rechg-timeout = <5400>;
		chg-end-cur = <120>;
		chg-polling-time = <15>;
		chg-polling-time-fast = <1>;
		cap-one-per-time = <30>;
		/*0 vol and cur,1 status and cur,2 ext ic*/
		chg-full-condition = <0>;
		temp-support = <1>;
		/*30mohm,if temp-table-mode = <1>, use it*/
		temp-comp-res = <6>;
		temp-tab-val = <1203 1095 986 878 775 678
				590 510 440 378 324 278
				238 204 175 150 129 111 96>;
		/* temperature + 1000,750 = 1000 + (-250)*/
		temp-tab-temp = <750 800 850 900 950 1000
				 1050 1100 1150 1200 1250 1300
				 1350 1400 1450 1500 1550 1600 1650>;
		jeita-temp-tab = <970 1100 1200 1450 1500>;
		jeita-temp-recovery-tab = <1000 1130 1230 1420 1500>;
		jeita-cur-tab = <0 1000 1000 0x7FFF 1000 0>;
		jeita-cccv-tab = <4400 4400 4400 4400 4100 4100>;
		fgu-mode = <0>;
		alm-soc = <5>;
		alm-vol = <3450>;
		soft-vbat-uvlo = <3050>;
		rint = <247>;
		cnom = <2979>;
		rsense-real = <199>;
		rsense-spec = <200>;
		relax-current = <50>;
		fgu-cal-ajust = <0>;
		ocv-tab-vol = <4371 4307 4248 4191 4136 4083 4035
				3989 3948 3892 3855 3829 3809 3792
				3777 3760 3741 3717 3687 3672 3400>;
		ocv-tab-cap = <100  95   90   85   80   75   70
				65   60   55   50   45   40   35
				 30   25   20   15   10   5    0>;
		cnom-temp-tab = <1020 1800	/*value = 1000 + temp*/
				1010 1300
				1000 1070
				990  1000>;
		rint-temp-tab = <1020 200	/*value = 1000 + temp*/
				1010 450
				1000 650
				990  1100>;
		};
};

